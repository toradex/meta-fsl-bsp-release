## imx/meta-bsp/conf/machine/apalis-imx8.conf
```bitbake
#@TYPE: Machine
#@NAME: Apalis iMX8
#@DESCRIPTION: Apalis iMX8 powered by a i.MX 8QuadMax SoC
#@MAINTAINER: Stefan Agner <stefan.agner@toradex.com>

SOC_SILICON_REV ?= ""

MACHINEOVERRIDES =. "mx8:mx8qm:${@bb.utils.contains('SOC_SILICON_REV', 'a0', 'mx8qma0:', '', d)}"

require conf/machine/include/imx-base.inc
require conf/machine/include/arm/arch-arm64.inc

# Don't include kernels in standard images
RDEPENDS_${KERNEL_PACKAGE_NAME}-base = ""

LOADADDR = ""

# We have to disable SERIAL_CONSOLE due to auto-serial-console
SERIAL_CONSOLE = "115200 ttyAMA1"

# we do not want to have getty running on tty1 as we run
# auto-serial-console there
USE_VT = "0"

KERNEL_DEVICETREE = "freescale/fsl-imx8qm-apalis.dtb"

UBOOT_MAKE_TARGET = "u-boot.bin"
UBOOT_SUFFIX = "bin"
UBOOT_CONFIG ??= "sd"
UBOOT_CONFIG[sd] = "apalis-imx8_config,sdcard"

BOOT_SPACE = "65536"
IMAGE_BOOTLOADER = "imx-boot"
IMX_BOOT_SEEK = "32"
IMX_BOOT_SEEK_mx8qma0 = "33"

IMAGE_BOOTFILES_DEPENDS += "firmware-imx:do_deploy"
IMAGE_BOOTFILES += "hdmitxfw.bin dpfw.bin"

SDCARD_GENERATION_COMMAND_mx8 = "generate_imx_sdcard"

PREFERRED_PROVIDER_virtual/kernel_mx8 = "linux-toradex"
PREFERRED_PROVIDER_virtual/bootloader_mx8 = "u-boot-toradex"
SOC_UAPI_HEADERS_mx8 = "linux-toradex-soc-headers"

MACHINE_FIRMWARE_append = " linux-firmware-pcie8997"

IMXBOOT_TARGETS = "${@bb.utils.contains('UBOOT_CONFIG', 'fspi', 'flash_b0_flexspi', \
                                                                 'flash_b0', d)}"

IMXBOOT_TARGETS_mx8qma0 = "${@bb.utils.contains('UBOOT_CONFIG', 'fspi', 'flash_flexspi', \
                       bb.utils.contains('UBOOT_CONFIG', 'nand', 'flash_nand', \
                                                                 'flash_multi_cores flash_dcd', d), d)}"

BOARD_TYPE = "apalis"
BOARD_TYPE_mx8qma0 = "a0-apalis"
```

## imx/meta-bsp/conf/machine/apalis-imx8a0.conf
```bitbake
SOC_SILICON_REV = "a0"

MACHINEOVERRIDES .= ":apalis-imx8"
require conf/machine/apalis-imx8.conf
```

## imx/meta-bsp/conf/machine/colibri-imx8qxp.conf
```bitbake
#@TYPE: Machine
#@NAME: Colibri iMX8QXP
#@DESCRIPTION: Colibri iMX8QXP powered by a i.MX 8QXP SoC
#@MAINTAINER: Max Krummenacher <max.krummenacherr@toradex.com>

MACHINEOVERRIDES =. "mx8:mx8qxp:"

require conf/machine/include/imx-base.inc
require conf/machine/include/arm/arch-arm64.inc

# Don't include kernels in standard images
RDEPENDS_${KERNEL_PACKAGE_NAME}-base = ""

LOADADDR = ""

# We have to disable SERIAL_CONSOLE due to auto-serial-console
SERIAL_CONSOLE = "115200 ttyAMA1"

# we do not want to have getty running on tty1 as we run
# auto-serial-console there
USE_VT = "0"

KERNEL_DEVICETREE = " \
    freescale/fsl-imx8qxp-colibri-eval-v3.dtb \
    freescale/fsl-imx8qxp-colibri-lvds-dual-eval-v3.dtb \
    freescale/fsl-imx8qxp-colibri-dsihdmi-eval-v3.dtb \
"

UBOOT_MAKE_TARGET = "u-boot.bin"
UBOOT_SUFFIX = "bin"
UBOOT_CONFIG ??= "sd"
UBOOT_CONFIG[sd] = "colibri-imx8qxp_config,sdcard"

BOOT_SPACE = "65536"
IMAGE_BOOTLOADER = "imx-boot"
IMX_BOOT_SEEK = "32"

PREFERRED_PROVIDER_virtual/kernel_mx8 = "linux-toradex"
PREFERRED_PROVIDER_virtual/bootloader_mx8 = "u-boot-toradex"
SOC_UAPI_HEADERS_mx8 = "linux-toradex-soc-headers"

MACHINE_FIRMWARE_append = " linux-firmware-pcie8997"

IMXBOOT_TARGETS = "${@bb.utils.contains('UBOOT_CONFIG', 'fspi', 'flash_flexspi', \
                                                                'flash_all flash', d)}"

BOARD_TYPE = "colibri"
```
